## recipes-bsp/u-boot/u-boot-stm32mp/falconmode_defconfig
```kconfig
CONFIG_SPL_OS_BOOT=y
CONFIG_CMD_SPL=y
CONFIG_SYS_SPL_ARGS_ADDR=0xC2000100
CONFIG_SPL_SIZE_LIMIT=0xB1000

# Falcon Mode 
CONFIG_FALCON_MODE=y
# CONFIG_SPL_FALCON_BOOT_MMCSD=y

CONFIG_SYS_MMCSD_RAW_MODE_KERNEL_SECTOR=0x1000  # Required for SPL code, but not used by config
```
